## Kconfig
```kconfig
config TOTEM_APDS_PROBE
	bool "Log the APDS9960's I2C registers at boot (diagnostic)"
	depends on I2C
	default n
	help
	  One-shot diagnostic: reads the ambient light sensor's ID register and
	  neighbors directly over I2C at boot and logs the values, to tell a
	  valid-but-unlisted chip id apart from an I2C communication problem.
	  Temporary; remove once the sensor is characterized.
```

## config/west.yml
```yaml
manifest:
  remotes:
    - name: zmkfirmware
      url-base: https://github.com/zmkfirmware
    - name: caksoylar
      url-base: https://github.com/caksoylar
    - name: porgey365
      url-base: https://github.com/Porgey365
  projects:
    # Overrides the "zephyr" project that zmk/app/west.yml below would
    # otherwise import from zmkfirmware/zephyr@v4.1.0+zmk-fixes. Same base
    # commit, plus a 2-line patch (drivers/sensor/apds9960) accepting our
    # dongle's clone APDS9960 chip id (0x9F) -- the stock driver hard-rejects
    # any id besides 0xAB/0x9C and there's no Kconfig to relax it. Import spec
    # copied verbatim from zmk/app/west.yml so submodules still resolve.
    - name: zephyr
      remote: porgey365
      revision: totem-apds9960-clone-id
      clone-depth: 1
      import:
        name-blocklist:
          - ci-tools
          - hal_altera
          - hal_cypress
          - hal_infineon
          - hal_microchip
          - hal_nxp
          - hal_openisa
          - hal_xtensa
          - hal_st
          - hal_ti
          - loramac-node
          - mcuboot
          - mcumgr
          - net-tools
          - openthread
          - edtt
          - trusted-firmware-m
    # zmk/app/west.yml also lists hal_stm32, lvgl, and zmk-studio-messages as
    # sibling projects to zephyr -- block only "zephyr" from this import
    # (already declared above, pointed at our fork) rather than duplicating
    # the whole project name, which caused west to drop those other projects.
    - name: zmk
      remote: zmkfirmware
      revision: main
      import:
        file: app/west.yml
        name-blocklist:
          - zephyr
    - name: zmk-rgbled-widget
      remote: caksoylar
      revision: main
    # Overrides carrefinho/prospector-zmk-module@feat/new-status-screens with
    # our own fork adding a display idle timeout (CONFIG_PROSPECTOR_IDLE_TIMEOUT_S)
    # -- upstream doesn't support turning the display off after inactivity.
    # We tried Cornix's zmk-dongle-screen module as a drop-in replacement
    # first, but it fails to build: two of its widgets (battery_status.c,
    # layer_roller.c) use LVGL v8 draw APIs that don't exist in the LVGL
    # version ZMK's current zephyr pin uses (lv_draw_ctx_t, mismatched
    # lv_draw_mask_fade_param_t/lv_draw_sw_mask_fade_param_t types) -- a
    # genuine upstream bug, not a config issue. Patching our own known-good
    # fork was more reliable than chasing that.
    - name: prospector-zmk-module
      remote: porgey365
      revision: totem-idle-timeout
  # zmk/app/west.yml sets this too, to re-include zephyr's "optional" group
  # (excluded by zephyr's own west.yml by default) -- needed for the Studio
  # build's nanopb dependency. Doesn't automatically propagate through our
  # filtered (name-blocklist) import above, so declaring it here directly.
  group-filter: [+optional]
  self:
    path: config
```
